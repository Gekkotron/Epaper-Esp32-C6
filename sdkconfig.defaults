## sdkconfig.defaults
```kconfig
# HTTP Server Configuration
CONFIG_HTTPD_MAX_REQ_HDR_LEN=1024
CONFIG_HTTPD_MAX_URI_LEN=512

# Increase stack sizes to prevent overflow
CONFIG_ESP_MAIN_TASK_STACK_SIZE=8192
CONFIG_HTTPD_STACK_SIZE=8192

# Enable more heap memory
CONFIG_ESP_SYSTEM_EVENT_TASK_STACK_SIZE=4096
```
